## CMakeLists.txt
```
#
# Copyright (c) 2018 Nordic Semiconductor
#
# SPDX-License-Identifier: LicenseRef-Nordic-5-Clause
#
cmake_minimum_required(VERSION 3.20.0)

find_package(Zephyr REQUIRED HINTS $ENV{ZEPHYR_BASE})
project(NONE)

# NORDIC SDK APP START
target_sources(app PRIVATE
  src/main.c
  src/simplest_interpreter.c
)

# Include UART ASYNC API adapter
target_sources_ifdef(CONFIG_BT_NUS_UART_ASYNC_ADAPTER app PRIVATE
  src/uart_async_adapter.c
)

# NORDIC SDK APP END

zephyr_library_include_directories(.)
```

## prj.conf
```kconfig
#
# Copyright (c) 2018 Nordic Semiconductor
#
# SPDX-License-Identifier: LicenseRef-Nordic-5-Clause
#

CONFIG_GPIO=y

# Make sure printk is printing to the RTT console
CONFIG_CONSOLE=y

CONFIG_HEAP_MEM_POOL_SIZE=2048

CONFIG_BT=y
CONFIG_BT_PERIPHERAL=y
CONFIG_BT_DEVICE_NAME="Nordic_UART_Service"
CONFIG_BT_DEVICE_APPEARANCE=833
CONFIG_BT_MAX_CONN=1
CONFIG_BT_MAX_PAIRED=1

# Enable the NUS service
CONFIG_BT_NUS=y

# Enable bonding
CONFIG_BT_SETTINGS=y
CONFIG_FLASH=y
CONFIG_FLASH_PAGE_LAYOUT=y
CONFIG_FLASH_MAP=y
CONFIG_NVS=y
CONFIG_SETTINGS=y

# Enable DK LED and Buttons library
CONFIG_DK_LIBRARY=y

# This example requires more workqueue stack
CONFIG_SYSTEM_WORKQUEUE_STACK_SIZE=2048

# Config logger
CONFIG_LOG=y
CONFIG_USE_SEGGER_RTT=y
CONFIG_LOG_BACKEND_RTT=y
CONFIG_LOG_BACKEND_UART=n
CONFIG_LOG_PRINTK=y

CONFIG_ASSERT=y

# Override NRF52840DK board settings in nrf52840dk_nrf52840_defconfig

CONFIG_SERIAL=n
CONFIG_UART_CONSOLE=n

# Enable the Segger RTT backend for logging

#CONFIG_USE_SEGGER_RTT=y
CONFIG_RTT_CONSOLE=y
#CONFIG_UART_CONSOLE=n

CONFIG_BT_NUS_SECURITY_ENABLED=n
CONFIG_BT_NUS_AUTHEN=n
```

## src/main.c
```c
/*
 * Copyright (c) 2018 Nordic Semiconductor ASA
 *
 * SPDX-License-Identifier: LicenseRef-Nordic-5-Clause
 */

/** @file
 *  @brief Nordic UART Bridge Service (NUS) sample
 */
#include <zephyr/types.h>
#include <zephyr/kernel.h>

#include <zephyr/device.h>
#include <zephyr/devicetree.h>
#include <soc.h>

#include <zephyr/bluetooth/bluetooth.h>
#include <zephyr/bluetooth/uuid.h>
#include <zephyr/bluetooth/gatt.h>
#include <zephyr/bluetooth/hci.h>

#include <bluetooth/services/nus.h>

#include <zephyr/settings/settings.h>

#include <stdio.h>

//#include <zephyr/logging/log.h> - in "simplest_interpreter.h"

#include <SEGGER_RTT.h>

#include "simplest_interpreter.h"

LOG_MODULE_REGISTER(LOG_MODULE_NAME, CONFIG_LOG_MAX_LEVEL);

#define RTT_IN_BUFSIZE 10 // number of characters to receive at a time in RTT console
char rtt_in_buf[RTT_IN_BUFSIZE]; //console input

// TODO: Create NUS write thread as was earlier
#define STACKSIZE CONFIG_BT_NUS_THREAD_STACK_SIZE
#define PRIORITY 7

#define DEVICE_NAME CONFIG_BT_DEVICE_NAME
#define DEVICE_NAME_LEN	(sizeof(DEVICE_NAME) - 1)

static struct bt_conn *current_conn;

static const struct bt_data ad[] = {
	BT_DATA_BYTES(BT_DATA_FLAGS, (BT_LE_AD_GENERAL | BT_LE_AD_NO_BREDR)),
	BT_DATA(BT_DATA_NAME_COMPLETE, DEVICE_NAME, DEVICE_NAME_LEN),
};

static const struct bt_data sd[] = {
	BT_DATA_BYTES(BT_DATA_UUID128_ALL, BT_UUID_NUS_VAL),
};

K_FIFO_DEFINE(fifo_program);

char buf_program_output[21];

bool fifo_has_enter = false;

static void connected(struct bt_conn *conn, uint8_t err)
{
	char addr[BT_ADDR_LE_STR_LEN];

	if (err) {
		LOG_ERR("Connection failed (err %u)", err);
		return;
	}

	bt_addr_le_to_str(bt_conn_get_dst(conn), addr, sizeof(addr));
	LOG_INF("Connected %s", addr);

	current_conn = bt_conn_ref(conn);
}

static void disconnected(struct bt_conn *conn, uint8_t reason)
{
	char addr[BT_ADDR_LE_STR_LEN];

	bt_addr_le_to_str(bt_conn_get_dst(conn), addr, sizeof(addr));

	LOG_INF("Disconnected: %s (reason %u)", addr, reason);

	if (current_conn) {
		bt_conn_unref(current_conn);
		current_conn = NULL;
	}
}

BT_CONN_CB_DEFINE(conn_callbacks) = {
	.connected    = connected,
	.disconnected = disconnected,
};

static void bt_receive_cb(struct bt_conn *conn, const uint8_t *const data,
			  uint16_t len)
{
	//int err;
	char addr[BT_ADDR_LE_STR_LEN] = {0};
    uint8_t count = 0;
	fifo_program_data_t *buf;


	bt_addr_le_to_str(bt_conn_get_dst(conn), addr, ARRAY_SIZE(addr));
	LOG_INF("Received data from: %s, now will be put in FIFO buffer", addr);
    LOG_HEXDUMP_DBG(data, len, "hexdump of received data:");
	
    while (count < len) {
        buf = k_malloc(sizeof(*buf));
		buf->data_byte = data[count];
        k_fifo_put(&fifo_program, buf);
        count++;

        if (data[count-1] == 13) {
			LOG_DBG("fifo_has_enter is set");
			fifo_has_enter = true;
		}
    }
}

static struct bt_nus_cb nus_cb = {
	.received = bt_receive_cb,
};

void error(void)
{
	while (true) {
		/* Spin for ever */
		k_sleep(K_MSEC(1000));
	}
}

int main(void)
{
	int err = 0;
    //char c;
    //unsigned int n = 0;
	struct fifo_program_data_t *buf;
    static uint8_t prompt[4]; prompt[0] = 13; prompt[1] = 10; prompt[2] = '>'; prompt[3] = ' ';


	printk("Entering main().\n");

    SEGGER_RTT_ConfigDownBuffer(0, "console", rtt_in_buf, sizeof(rtt_in_buf), SEGGER_RTT_MODE_NO_BLOCK_TRIM);
    
	err = bt_enable(NULL);
	if (err) {
		error();
	}

	LOG_INF("Bluetooth initialized");

	if (IS_ENABLED(CONFIG_SETTINGS)) {
		settings_load();
	}

	err = bt_nus_init(&nus_cb);
	if (err) {
		LOG_ERR("Failed to initialize UART service (err: %d)", err);
		return 0;
	}

	err = bt_le_adv_start(BT_LE_ADV_CONN, ad, ARRAY_SIZE(ad), sd,
			      ARRAY_SIZE(sd));
	if (err) {
		LOG_ERR("Advertising failed to start (err %d)", err);
		return 0;
	}

	for (;;) {
    
		/*n = SEGGER_RTT_Read(0, &c, 1); // read one character from RTT
		if (n) {
			n = 0;
			if (bt_nus_send(NULL, &c, 1)) {
				LOG_WRN("Failed to send data over BLE connection");
		    }
		}*/

		if (fifo_has_enter) {
            evaluate_fifo_buffer();
            fifo_has_enter = false;
            LOG_DBG("Evaluated buf_program_output result: %s", buf_program_output);
            if (bt_nus_send(NULL, buf_program_output, strlen(buf_program_output))) {
			    LOG_WRN("Failed to send data over BLE connection");
			}
            if (bt_nus_send(NULL, prompt, 4)) {
				LOG_WRN("Failed to send prompt over BLE connection");
			}
		}

		k_sleep(K_MSEC(5000));
	}
}
```

## src/simplest_interpreter.c
```c
#include <zephyr/types.h>
#include <zephyr/kernel.h>

#include "simplest_interpreter.h"

LOG_MODULE_DECLARE(LOG_MODULE_NAME, CONFIG_LOG_MAX_LEVEL);

extern struct k_fifo fifo_program;
extern char buf_program_output[20];
extern bool fifo_has_enter;

void evaluate_fifo_buffer(void) {
	uint8_t count = 0;
	fifo_program_data_t *buf;
    
	LOG_DBG("From evaluate_fifo_buffer()");
    buf = k_fifo_get(&fifo_program, K_NO_WAIT);
	while (buf) {
		if (buf->data_byte >= 97 && buf->data_byte <=122) {
			buf_program_output[count] = buf->data_byte - 32;
		}
		else {
			buf_program_output[count] = buf->data_byte;
		}
        count++;
		buf = k_fifo_get(&fifo_program, K_NO_WAIT);
	}
	buf_program_output[count] = 0;
	
	return;
}
```

## src/simplest_interpreter.h
```c
#include <zephyr/logging/log.h>

#define LOG_MODULE_NAME app

typedef struct tag_fifo_program_data_t {
	void *fifo_reserved;
	uint8_t data_byte;
} fifo_program_data_t;

void evaluate_fifo_buffer(void);
```
